/dts-v1/;
/plugin/;

/ {
	compatible = "rockchip,rk3328";

	fragment@0 {
		target = <&spi0>;
		__overlay__ {
			#address-cells = <1>;
			#size-cells = <0>;
			spidev {
				compatible = "rockchip,spidev";
				status = "disabled";
				reg = <0>;
				spi-max-frequency = <10000000>;
			};
		};
	};
};
